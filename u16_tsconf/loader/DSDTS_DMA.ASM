P_CONF  EQU #77
P_DATA  EQU #57

CMD_12  EQU #4C
CMD_18  EQU #52
CMD_25  EQU #59
CMD_55  EQU #77
CMD_58  EQU #7A
CMD_59  EQU #7B
ACMD_41 EQU #69
;------------------------------------------------
;------------------------------------------------
;INIsd   JP SD__OFF
;============READ SECTORs =======================
;i    
;	HL - destination ADDR
; 	A  - Nof Sector for Read
;       (BLKNUM), (BLKNUM+2) - Sector Address
RDDXX
RDDSE
RDDSEsd LD DE,(BLKNUM)
        LD BC,(BLKNUM+2)
        EXA 
	;SPI: CMD_18, BC, DE, 0x00 ==============
        LD A,CMD_18:CALL SECM200 ;SET SECTOR ADDR
        EXA
RD1     EXA
        CALL IN_OUT:CP #FE:JR NZ,$-5
        CALL READSsd ; READ SECTOR with DMA
        EXA
        DEC A:JR NZ,RD1 ; READ N-sectors

        LD A,CMD_12     ; STOP MULTIREAD
        CALL OUT_COM
        CALL IN_OUT:INC A:JR NZ,$-4
        JP CS_HIGH
;=========================>  CS_HIGH => RET

;=======READ Sector =========================================================
;i:   	A  - страница приемника  
;	HL - адрес приемника 
READSsd PUSH BC,DE

        CALL PREDMA ; проверяем адрес и страницу(Win2,3->Page=0xF7) приемника	
	;==========
        LD B,DMADX/256:OUT (C),A ;адрес страницы приемника =====
	;========UART===================0x9200 Win(2) PAGE2=0xF7
	;CALL COM_TX ;               0xF7 - страница
	;LD A, D : CALL COM_TX ;     0x12 - старшая часть адреса
	;LD A, L : CALL COM_TX ;     0x00 - младшая часть адреса
        ;========================================================
        DEC B:OUT (C),D          ;старгиая часть адреса приемника
        DEC B:OUT (C),L          ;младшая  часть адреса приемика
        LD B,DMA_T/256:XOR A:OUT (C),A       ; один бурст
        LD B,DMA_N/256:DEC A:OUT (C),A       ; 512 Byte 
        LD B,DMA_C/256,A,%00000010:OUT (C),A ; SPI data is copied to RAM (Dst)

        CALL POSDMA ; HL+512 - адрес приемника, страница

        LD BC,P_DATA
	IN A,(C) : IN A,(C)
        POP DE,BC
        RET
;------------------------------------------------------
CMD00	DB #40,#00,#00,#00,#00,#95	; GO_IDLE_STATE
CMD08	DB #48,#00,#00,#01,#AA,#87	; SEND_IF_COND
CMD16	DB #50,#00,#00,#02,#00,#FF	; SET_BLOCKEN
;------------------------------------------------------
SEL_DEV
SELsd   ;i:A - N of Dev : DON't NEED TO CHECK
        ;OR A:RET NZ  ; just 1 driver (for SD)
DRDET   CALL SD_INIT
        LD DE,2:OR A:RET NZ
        LD DE,0
        RET	
;=======================================================
;================SD_INIT================================
SD_INIT CALL CS_HIGH
        LD BC,P_DATA,DE,#10FF
        OUT (C),E:DEC D:JR NZ,$-3
        XOR A:EXA
ZAW001  LD HL,CMD00:CALL OUTCOM,IN_OUT
        EXA:DEC A:JR Z,ZAW003
        EXA:DEC A:JR NZ,ZAW001
        LD HL,CMD08:CALL OUTCOM,IN_OUT
	IN H,(C)
	NOP
	IN H,(C)
	NOP
	IN H,(C)
	NOP
	IN H,(C)
        LD HL,0:BIT 2,A
        JR NZ,ZAW006:LD H,#40
ZAW006  LD A,CMD_55:CALL OUT_COM,IN_OUT
        LD A,ACMD_41:OUT (C),A:NOP
        OUT (C),H:NOP
        OUT (C),L:NOP
        OUT (C),L:NOP
        OUT (C),L
        LD A,#FF:OUT (C),A
        CALL IN_OUT:AND A:JR NZ,ZAW006
ZAW004  LD A,CMD_59:CALL OUT_COM,IN_OUT
        AND A:JR NZ,ZAW004
ZAW005  LD HL,CMD16:CALL OUTCOM,IN_OUT
	;===============DEBUG ==========   CMD16 ========== !!!!!!!!!!!
	;CALL COM_TX   ;  send  A : 0x0  (SD/SDHC)
	;=======================================
        AND A:JR NZ,ZAW005

CS_HIGH PUSH DE,BC
        LD E,3,BC,P_CONF
        OUT (C),E:LD E,0,C,P_DATA
        OUT (C),E
        POP BC,DE
        RET

ZAW003  CALL SD__OFF
        LD A,1
        RET

SD__OFF XOR A
        OUT (P_CONF),A
        OUT (P_DATA),A
        RET

CS__LOW PUSH DE,BC
        LD BC,P_CONF,E,1:OUT (C),E
        POP BC,DE
        RET

OUTCOM  CALL CS__LOW
        PUSH BC
        LD BC,P_DATA
	OUTI:NOP : OUTI:NOP : OUTI:NOP
	OUTI:NOP : OUTI:NOP : OUTI:NOP
        POP BC
        RET

OUT_COM PUSH BC
        CALL CS__LOW
        LD BC,P_DATA
        OUT (C),A:XOR A
	OUT (C),A:NOP
	OUT (C),A:NOP
	OUT (C),A:NOP
        OUT (C),A:DEC A
        OUT (C),A
        POP BC
        RET

SECM200 PUSH HL,DE,BC,AF,BC
        LD BC,P_DATA,A,CMD_58
        CALL OUT_COM,IN_OUT
        IN A,(C):NOP
        IN H,(C):NOP
        IN H,(C):NOP
        IN H,(C):BIT 6,A:POP HL
        JR NZ,SECN200
        EX DE,HL:ADD HL,HL:EX DE,HL
        ADC HL,HL
        LD H,L,L,D,D,E,E,0
SECN200 POP AF
        LD BC,P_DATA:OUT (C),A
        NOP:OUT (C),H
        NOP:OUT (C),L
        NOP:OUT (C),D
        NOP:OUT (C),E
        LD A,#FF:OUT (C),A
        POP BC,DE,HL
        RET

IN_OUT  PUSH BC,DE
        LD DE,#10FF
        LD BC,P_DATA
IN_WAIT IN A,(C)
        CP E:JR NZ,IN_EXIT
IN_NEXT DEC D:JR NZ,IN_WAIT
IN_EXIT POP DE,BC
        RET
;=============================DMA=================================================
;--------------------------------------------------------------------------------
; Для Win 2,3 автоматически идет запись в страницу     PG0(нолик)=0xF7, - служ инф 
; для Win 0,1 номер страницы находится в ячейке памяти PGO(буковка"O")  - данные
;PGO     EQU ZES+1;2;Temp Page
;PGR     EQU PGO+2;2;Restore Page
PREDMA  ; i:
	; 	HL - dest adress
	; o:    A  - PAGE
	; 	DL - dest adress
	LD C,PG0 ; C<-PG0  // PG0 EQU #F7
	LD A,H   ; A<-DEST ADDR (A15, A14 = no meaning)
        CP #80:JR NC,$+6: ;if A>0x80 then go to mask    :A15=1 (Win2,3)  
	LD BC,(PGO)   	  ;if A<0x80 then BC<-(Temp Page)      (Win0,1)
	
;mask	
        AND %00111111 ; mask A15, A14 = 0x0
        LD D,A,A,C    ; D<-A [hi byte of dest addr] ; A<-C [page =0xF7]

        LD BC,STS
	INF:JP M,$-2  ; проверяем готовность
        RET
	
;--------------------------------------------------
	;i:
	; 	HL       - dest adress
	;o:
	; 	HL(+512) - dest adress	
POSDMA  LD DE,512:ADD HL,DE  ;  HL+512, 
        LD A,H
        CP #40:JR C, TSDL    ; when A < 0x40, RETURN : A14,A15 =0, same PAGE
        CP #80:JR NC,TSDL    ; when A15 = 1,  RETURN : A15=1       (Win2,3) 
        AND %00111111:LD H,A ; ELSE: mask A15, A14 = 0x0
        LD A,(PGO):INC A     ; (PG0)++ //счетчик страниц для DMA ?
        LD (PGO),A
	
TSDL    INF:JP M,$-2
        RET
;--------------------------------------------------------------------------------
STS     EQU #27AF ;DMACtrl      СТАТУС
;------------------------------ адрес источника 
DMASL   EQU #1AAF ; - DMASAddrL внутри страницы
DMASH   EQU #1BAF ; - DMASAddrH внутри страницы
DMASX   EQU #1CAF ; - адрес  страницы источника
;------------------------------ адрес приемника  
DMADL   EQU #1DAF ;внутри страницы Lo
DMADH   EQU #1EAF ;внутри страницы Hi
DMADX   EQU #1FAF ;адресс страницы приемника
;------------------------------------------------
DMA_T   EQU #28AF ;0=1, 255=256 количество бурстов
DMA_N   EQU #26AF ;255=512 // длина буста в диапазоне 2..512 байт с шагом 2 байта. 
DMA_C   EQU #27AF ;RW 1 - - - 0 0 1
;---------------------------------------------------------------------------------
